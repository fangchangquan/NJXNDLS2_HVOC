#include "i2c.h"
#include "motor.h"


u8 sum_temp[N10]={0};
u8 sum_a_temp[N10]={0};
u8 sum_b_temp[N10]={0};
u8 sum_c_temp[N10]={0};
u8 rd_temp[N10]={0};
u16 net_rst_cnt=0;
EEPROM_t e2;


//===============================================================
/*********************************************************************************
** 函数名称: I2C_GPIO_Init
** 编写者  ：CZM
** 函数功能：调节等离子体强度
** 输入参数：无
** 输出参数：无
** 备    注：无
*********************************************************************************/
void I2C_GPIO_Init(void)
{
GPIO_InitTypeDef GPIO_InitStructure;

RCC_AHB1PeriphClockCmd(RCC_AHB1Periph_GPIOB,ENABLE);

GPIO_InitStructure.GPIO_Pin=GPIO_Pin_8|GPIO_Pin_9;
GPIO_InitStructure.GPIO_Mode = GPIO_Mode_OUT;		
GPIO_InitStructure.GPIO_OType=GPIO_OType_OD;
GPIO_InitStructure.GPIO_Speed=GPIO_Speed_50MHz;
GPIO_InitStructure.GPIO_PuPd = GPIO_PuPd_UP;	
GPIO_Init(GPIOB,&GPIO_InitStructure);

I2C_SCL_HIGH();
I2C_SDA_HIGH();

Delay_Ms(10);	

}
//===============================================================
/*********************************************************************************
** 函数名称: Clear_Sum_Temp
** 编写者  ：CZM
** 函数功能：调节等离子体强度
** 输入参数：无
** 输出参数：无
** 备    注：无
*********************************************************************************/
void Clear_Sum_Temp(void)
{
u16 i;
for(i=0;i<N10;i++)
{
   sum_temp[i]=0;
}
}

//===============================================================
/*********************************************************************************
** 函数名称: I2C_Start
** 编写者  ：CZM
** 函数功能：调节等离子体强度
** 输入参数：无
** 输出参数：无
** 备    注：无
*********************************************************************************/
void I2C_Start(void)
{
SDA_OUT();

I2C_SDA_HIGH();
I2C_SCL_HIGH();	
delay_us(5);
I2C_SDA_LOW();
delay_us(5);
I2C_SCL_LOW();
delay_us(5);
}
//===============================================================
/*********************************************************************************
** 函数名称: I2C_Stop
** 编写者  ：CZM
** 函数功能：调节等离子体强度
** 输入参数：无
** 输出参数：无
** 备    注：无
*********************************************************************************/
void I2C_Stop(void)
{
SDA_OUT();
I2C_SDA_LOW();
I2C_SCL_LOW();
	
delay_us(5);
I2C_SCL_HIGH();
delay_us(5);
I2C_SDA_HIGH();	

}
//===============================================================
/*********************************************************************************
** 函数名称: I2C_Wait_Ack
** 编写者  ：CZM
** 函数功能：调节等离子体强度
** 输入参数：无
** 输出参数：无
** 备    注：无
*********************************************************************************/
void I2C_Wait_Ack(void)			 //=1:err;=0:success
{
uchar errtime=0;
SDA_IN();
I2C_SDA_HIGH();
delay_us(1);
I2C_SCL_HIGH();
delay_us(1);
while(READ_SDA())
{
errtime++;
if(errtime>250)
{
I2C_Stop();
return;
}
}
I2C_SCL_LOW();
//delay_us(5);
}
//===============================================================
/*********************************************************************************
** 函数名称: I2C_Ack
** 编写者  ：CZM
** 函数功能：调节等离子体强度
** 输入参数：无
** 输出参数：无
** 备    注：无
*********************************************************************************/
void I2C_Ack(void)
{
SDA_OUT();
I2C_SCL_LOW();

I2C_SDA_LOW();
delay_us(2);
I2C_SCL_HIGH();
delay_us(2);
I2C_SCL_LOW();
}
//===============================================================
/*********************************************************************************
** 函数名称: I2C_Nack
** 编写者  ：CZM
** 函数功能：调节等离子体强度
** 输入参数：无
** 输出参数：无
** 备    注：无
*********************************************************************************/
void I2C_Nack(void)
{
SDA_OUT();
I2C_SCL_LOW();
I2C_SDA_HIGH();
delay_us(2);
I2C_SCL_HIGH();
delay_us(2);
I2C_SCL_LOW();

}
//===============================================================
/*********************************************************************************
** 函数名称: I2C_Send_Byte
** 编写者  ：CZM
** 函数功能：调节等离子体强度
** 输入参数：无
** 输出参数：无
** 备    注：无
*********************************************************************************/
void I2C_Send_Byte(u8 data)
{
u8 i,j;
j=0x80;
SDA_OUT();
I2C_SCL_LOW();
for(i=0;i<8;i++)
{
if((data&j)==0)
{
I2C_SDA_LOW();
}
else
{ 
I2C_SDA_HIGH();
}
data<<=1;
delay_us(3);
I2C_SCL_HIGH();
delay_us(3);
I2C_SCL_LOW();
delay_us(3);
}
}
//===============================================================
/*********************************************************************************
** 函数名称: I2C_Read_Byte
** 编写者  ：CZM
** 函数功能：调节等离子体强度
** 输入参数：无
** 输出参数：无
** 备    注：无
*********************************************************************************/
u8 I2C_Read_Byte(void)
{
uchar i;
u8 receive=0;
SDA_IN();
for(i=0;i<8;i++)
{
I2C_SCL_HIGH();
delay_us(3);
I2C_SCL_HIGH();
receive<<=1;
if(READ_SDA())
{
receive|=0x01;
}
I2C_SCL_LOW();
delay_us(3);
}
SDA_OUT();
return receive;
}

//===============================================================
/*********************************************************************************
** 函数名称: Bme280_Write_OneByte
** 编写者  ：CZM
** 函数功能：调节等离子体强度
** 输入参数：无
** 输出参数：无
** 备    注：无
*********************************************************************************/
void Bme280_Write_OneByte(u8 addr,u8 data)
{
I2C_Start();
I2C_Send_Byte(BMP280_WR_ADDR);
I2C_Wait_Ack();
I2C_Send_Byte(addr);
I2C_Wait_Ack();
I2C_Send_Byte(data);
I2C_Wait_Ack();
I2C_Stop();
Delay_Ms(1);
}
//===============================================================
/*********************************************************************************
** 函数名称: Bme280_Read_OneByte
** 编写者  ：CZM
** 函数功能：调节等离子体强度
** 输入参数：无
** 输出参数：无
** 备    注：无
*********************************************************************************/
u8 Bme280_Read_OneByte(u8 addr)
{
u8 temp=0;
I2C_Start();
I2C_Send_Byte(BMP280_WR_ADDR);
I2C_Wait_Ack();
I2C_Send_Byte(addr);
I2C_Wait_Ack();
I2C_Start();
I2C_Send_Byte(BMP280_RD_ADDR);
I2C_Wait_Ack();
temp=I2C_Read_Byte();
I2C_Nack();
I2C_Stop();
delay_us(100);
return temp;
}
//===============================================================
/*********************************************************************************
** 函数名称: Bmp280_Read_Para
** 编写者  ：CZM
** 函数功能：调节等离子体强度
** 输入参数：无
** 输出参数：无
** 备    注：无
*********************************************************************************/
short Bmp280_Read_Para(u8 addr1,u8 addr2)
{
	 short par=0;
	 u8 msb,lsb;
	 
	 msb=Bme280_Read_OneByte(addr1);
	 lsb=Bme280_Read_OneByte(addr2);
	
	 par=msb<<8;
	 par|=lsb;
	
	 return par;
}
//===============================================================
/*********************************************************************************
** 函数名称: Bme280_Read_nByte
** 编写者  ：CZM
** 函数功能：调节等离子体强度
** 输入参数：无
** 输出参数：无
** 备    注：无
*********************************************************************************/


//===============================================================
/*********************************************************************************
** 函数名称: Double_Led_Charge_Control
** 编写者  ：CZM
** 函数功能：调节等离子体强度
** 输入参数：无
** 输出参数：无
** 备    注：无
*********************************************************************************/

//===============================================================
/*********************************************************************************
** 函数名称: Double_Led_Charge_Control
** 编写者  ：CZM
** 函数功能：调节等离子体强度
** 输入参数：无
** 输出参数：无
** 备    注：无
*********************************************************************************/

//===============================================================
/*********************************************************************************
** 函数名称: Double_Led_Charge_Control
** 编写者  ：CZM
** 函数功能：调节等离子体强度
** 输入参数：无
** 输出参数：无
** 备    注：无
*********************************************************************************/

//===============================================================
/*********************************************************************************
** 函数名称: Double_Led_Charge_Control
** 编写者  ：CZM
** 函数功能：调节等离子体强度
** 输入参数：无
** 输出参数：无
** 备    注：无
*********************************************************************************/

//===============================================================
/*********************************************************************************
** 函数名称: Double_Led_Charge_Control
** 编写者  ：CZM
** 函数功能：调节等离子体强度
** 输入参数：无
** 输出参数：无
** 备    注：无
*********************************************************************************/

//===============================================================
/*********************************************************************************
** 函数名称: Double_Led_Charge_Control
** 编写者  ：CZM
** 函数功能：调节等离子体强度
** 输入参数：无
** 输出参数：无
** 备    注：无
*********************************************************************************/
//===============================================================

/*********************************************************************************
** 函数名称: Double_Led_Charge_Control
** 编写者  ：CZM
** 函数功能：调节等离子体强度
** 输入参数：无
** 输出参数：无
** 备    注：无
*********************************************************************************/
//===============================================================
/*********************************************************************************
** 函数名称: Double_Led_Charge_Control
** 编写者  ：CZM
** 函数功能：调节等离子体强度
** 输入参数：无
** 输出参数：无
** 备    注：无
*********************************************************************************/

